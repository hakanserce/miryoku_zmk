// Copyright 2021 Manna Harbour
// https://github.com/manna-harbour/miryoku

#include "../miryoku/custom_config.h"
#include "../miryoku/mapping/36/serce42.h" //same, reusing serce42
#include "../miryoku/miryoku.dtsi"
